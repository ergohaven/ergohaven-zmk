## boards/arm/nrfmicro/Kconfig.board
```kconfig
# nrfmicro board configuration

# Copyright (c) 2020 The ZMK Contributors
# SPDX-License-Identifier: MIT

config BOARD_NRFMICRO_13
    bool "nrfmicro_13"
    depends on SOC_NRF52840_QIAA
```

## boards/arm/nrfmicro/Kconfig.defconfig
```kconfig
# Electronut Labs Papyr board configuration

# Copyright (c) 2020 The ZMK Contributors
# SPDX-License-Identifier: MIT

if  BOARD_NRFMICRO_13

config BOARD
    default "nrfmicro"

if USB_DEVICE_STACK

config USB_NRFX
    default y

endif # USB_DEVICE_STACK

config BT_CTLR
    default BT

config BOARD_NRFMICRO_CHARGER
    default y

endif #  BOARD_NRFMICRO_13
```

## boards/shields/broom/Kconfig.defconfig
```kconfig
if SHIELD_BROOM_QUBE || SHIELD_BROOM_LEFT

config ZMK_KEYBOARD_NAME
    default "K:03"

config ZMK_SPLIT_ROLE_CENTRAL
    default y

endif

if SHIELD_BROOM_QUBE || SHIELD_BROOM_LEFT_QUBE || SHIELD_BROOM_LEFT || SHIELD_BROOM_RIGHT

config ZMK_SPLIT
    default y

config ZMK_POINTING
    default y

endif
```

## boards/shields/broom/Kconfig.shield
```kconfig
config SHIELD_BROOM_LEFT_QUBE
    def_bool $(shields_list_contains,broom_left_qube)

config SHIELD_BROOM_QUBE
    def_bool $(shields_list_contains,broom_qube)

config SHIELD_BROOM_LEFT
    def_bool $(shields_list_contains,broom_left)

config SHIELD_BROOM_RIGHT
    def_bool $(shields_list_contains,broom_right)
```

## boards/shields/k03/Kconfig.shield
```kconfig
config SHIELD_K03_LEFT
    def_bool $(shields_list_contains,k03_left)

config SHIELD_K03_RIGHT
    def_bool $(shields_list_contains,k03_right)
```

## boards/shields/velvet_v3/Kconfig.defconfig
```kconfig
if SHIELD_VELVET_V3_LEFT

config ZMK_KEYBOARD_NAME
    default "Velvet_v3"

config ZMK_SPLIT_ROLE_CENTRAL
    default y

endif

if SHIELD_VELVET_V3_LEFT || SHIELD_VELVET_V3_RIGHT

config ZMK_SPLIT
    default y

config ZMK_POINTING
    default y

endif
```

## boards/shields/velvet_v3_ui/Kconfig.defconfig
```kconfig
if SHIELD_VELVET_V3_UI_LEFT

config ZMK_KEYBOARD_NAME
    default "Velvet_v3_UI"

config ZMK_SPLIT_ROLE_CENTRAL
    default y

endif

if SHIELD_VELVET_V3_UI_LEFT || SHIELD_VELVET_V3_UI_RIGHT

config ZMK_SPLIT
    default y

endif
```

## config/west.yml
```yaml
manifest:
  remotes:
    - name: zmkfirmware
      url-base: https://github.com/zmkfirmware
    - name: ergohaven
      url-base: https://github.com/ergohaven
    - name: kot149
      url-base: https://github.com/kot149
    - name: hsgw
      url-base: https://github.com/hsgw
  projects:
    - name: zmk
      remote: zmkfirmware
      revision: v0.3.0
      import: app/west.yml
    - name: zmk-pmw3610-driver
      remote: ergohaven
      revision: eh
    - name: ergohaven-zmk-qube
      remote: ergohaven
      revision: eh
    - name: zmk-raw-hid
      remote: ergohaven
      revision: main
    - name: zmk-scroll-snap
      remote: kot149
      revision: v1
    - name: zmk-feature-sensor_rotation
      remote: hsgw
      revision: e1a0186220ade99220d04dadf9735b758cfdf086
  self:
    path: config
```
